## ESP-IDF/components/wt32_sc01/Kconfig.projbuild
```kconfig
menu "WT32-SC01 Board Configuration"
    config WT32_SC01_ENABLE_LCD
        bool "Enable LCD"
        default y
    config WT32_SC01_ENABLE_TOUCHSCREEN
        bool "Enable Touchscreen"
        default y
    endmenu
    
```

## Emulator/components/LCD/Kconfig.projbuild
```kconfig
menu "ESP32-64KEmulator Configuration"
    menu "Device Config"
        choice ESP32_DEVICE_SELECTED
            default WT32_SC01_H
            prompt "Select the device"
            config WT32_DEVICE_NONE
                bool "Select a supported device"
            config WT32_SC01_H
                bool "Wireless-Tag WT32-SC01 - SPI - 4MB Flash"
                help
                    This is the device with 4MB Flash on a WT32-SC01 device.
        endchoice
    endmenu
endmenu
```

## MacintoshESPEmulator/main/Kconfig.projbuild
```kconfig
menu "Macintosh Emulator Configuration"
    menu "Device Config"
        choice ESP32_DEVICE_SELECTED
            default WT32_SC01_H
            prompt "Select the device"
            config WT32_DEVICE_NONE
                bool "Select a supported device"
            config WT32_SC01_H
                bool "Wireless-Tag WT32-SC01 - SPI - 16MB Flash / 8MB PSRAM"
                help
                    WT32-SC01-3.4 with ESP32-WROVER-B, ST7796 LCD, FT5x06 touch.
        endchoice
    endmenu
endmenu
```

## MacintoshESPEmulator/sdkconfig.defaults
```kconfig
# Macintosh Emulator SDK Configuration Defaults
# Target: ESP32-WROVER-B (WT32-SC01-3.4)

# --- Target ---
CONFIG_IDF_TARGET="esp32"

# --- CPU ---
CONFIG_ESP_DEFAULT_CPU_FREQ_MHZ_240=y

# --- Flash (16MB) ---

CONFIG_ESPTOOLPY_FLASHFREQ_80M=y
CONFIG_ESPTOOLPY_FLASHSIZE_4MB=y

# --- PSRAM (8MB) ---
CONFIG_SPIRAM=y
CONFIG_SPIRAM_MODE_QUAD=y
CONFIG_SPIRAM_SPEED_80M=y
CONFIG_SPIRAM_USE_CAPS_ALLOC=y
CONFIG_SPIRAM_MALLOC_ALWAYSINTERNAL=4096
CONFIG_SPIRAM_TRY_ALLOCATE_WIFI_LWIP=y
CONFIG_SPIRAM_ALLOW_BSS_SEG_EXTERNAL_MEMORY=y

# --- Partition Table ---
CONFIG_PARTITION_TABLE_CUSTOM=y
CONFIG_PARTITION_TABLE_CUSTOM_FILENAME="partitions.csv"

# --- FreeRTOS ---
CONFIG_FREERTOS_HZ=1000

# --- Log level (reduce for performance) ---
CONFIG_LOG_DEFAULT_LEVEL_INFO=y

# --- Compiler optimizations ---
CONFIG_COMPILER_OPTIMIZATION_PERF=y

# --- WT32-SC01 device selection ---
CONFIG_WT32_SC01_H=y

# QIO flash: +1.1% idle speed vs DIO on WT32-SC01 (measured 2026-10-20)
CONFIG_ESPTOOLPY_FLASHMODE_QIO=y
```
